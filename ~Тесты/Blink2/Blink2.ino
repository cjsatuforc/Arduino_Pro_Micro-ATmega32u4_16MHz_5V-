/*
 *v1.0_Write_by_ImaSoft
 */


//-------------------------------------------------------------- //
//#include <EEPROM.h>                                              //Стандартная_библиотека_для_работы_с_EEPROM_памятью
//-------------------------------------------------------------- //

//-------------------------------------------------------------- //
#define LED1Pin               17                                 //Выход_первого_светодиода
#define LEDTIME               250                                //Интервал_времени(ms)_мигания_светодиодов
//---Разрешить_прерывание_от_компаратора_OCR0A------------------ //
#define STARTTIMERCOMPA {OCR0A = 0x7;TIMSK0 |= _BV(OCIE0A);}     //Используем_прерывание_от_компаратора_OCR0A_таймера-0,_расчетное_время_вызова:1/(8000000(частота_генератора_ЦПУ)/64(делитель_по_умолчанию)/256(полное_время_таймера_TCN0L))=0,002048мСб_так_как_таймер_TCN0L_не_сбрасывается_в_ноль_по_достижению_значения_компаратора_то_время_генерации_прерывания_будет_равно_времени_полного_цикла_таймера_TCN0L
//-------------------------------------------------------------- //





//***START_SIGNAL**********************************************//Прерывание_вызывается_один_раз_в_миллисекунду
unsigned long Time1_COUNT     = 0;                             //Счетчик_времени_таймера-1
unsigned long Time_COUNT_Bak  = 0;                             //Прошлое_значение_счетчик_времени
boolean FLSTARTLED            = false;                         //Флаг_разрешения_мигания_светодиода
boolean FLONOFFLED            = false;                         //Флаг_ВКЛ/ОТКЛ_светодиода_LED1
//-------------------------------------------------------------//
SIGNAL(TIMER0_COMPA_vect) {                                    //
//ISR(TIMER0_COMPA_vect) {                                     //
 //------------------------------------------------------------//
 TIMSK0 ^= _BV(OCIE0A);                                        //Запритить_прерывание_от_компаратора_OCR0A(В_PWM-6pin),_то_есть,_нельзя_использовать_одновременно_вывод_PWM_на_ножку-6_и_прерывание
 unsigned long milis = millis();                               //
 //--FLASHER-LED-----------------------------------------------//
 Time1_COUNT += milis-Time_COUNT_Bak;                          //
 if ((Time1_COUNT >= LEDTIME) && (FLSTARTLED==true)) {Time1_COUNT=0;
  if (FLONOFFLED) {digitalWrite(LED1Pin,HIGH);PORTD &=~(1<<5);FLONOFFLED=false;}
  else {digitalWrite(LED1Pin,LOW);PORTD |=(1<<5);FLONOFFLED=true;}
 }                                                             //
 else {if (FLSTARTLED==false) {Time1_COUNT=0;digitalWrite(LED1Pin,HIGH);PORTD |=(1<<5);FLONOFFLED=false;}}
 //------------------------------------------------------------//
 Time_COUNT_Bak = milis;                                       //
 TIMSK0 |= _BV(OCIE0A);                                        //Разрешить_прерывание_от_компаратора_OCR0A(В_PWM-6pin),_то_есть,_нельзя_использовать_одновременно_вывод_PWM_на_ножку-6_и_прерывание
 //------------------------------------------------------------//
}                                                              //
//***END_SIGNAL************************************************//





//***START_Setup***********************************************//
void setup() {                                                 //
  pinMode(LED1Pin,OUTPUT);                                     //
  digitalWrite(LED1Pin,LOW);PORTD &=~(1<<5);                   //
  //---------------------------------------------------------- //
  FLSTARTLED = true;                                           //
  //---------------------------------------------------------- //
  STARTTIMERCOMPA;                                             //
  //---------------------------------------------------------- //
}                                                              //
//***END_Setup*************************************************//


//***START_loop************************************************//
void loop() {                                                  //
 //------------------------------------------------------------//
 
 //------------------------------------------------------------//
}                                                              //
//***END_loop**************************************************//
